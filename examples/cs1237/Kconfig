## examples/cs1237/Kconfig
```kconfig
#
# For a description of the syntax of this configuration file,
# see the file kconfig-language.txt in the NuttX tools repository.
#

config EXAMPLES_CS1237
	tristate "\"cs1237\" example"
	default n
	---help---
		Enable the \"cs1237\" example

if EXAMPLES_CS1237

config EXAMPLES_CS1237_PROGNAME
	string "Program name"
	default "cs1237"
	depends on BUILD_LOADABLE
	---help---
		This is the name of the program that will be use when the NSH ELF
		program is installed.

config EXAMPLES_CS1237_PRIORITY
	int "cs1237 task priority"
	default 60

config EXAMPLES_CS1237_STACKSIZE
	int "cs1237 stack size"
	default 2048

endif
```

## examples/fishled/Kconfig
```kconfig
#
# For a description of the syntax of this configuration file,
# see the file kconfig-language.txt in the NuttX tools repository.
#

config EXAMPLES_FISHLED
	tristate "FISHLED example"
	default n
	depends on FISHLED
	---help---
		Enable the FISHLED example

if EXAMPLES_FISHLED

config EXAMPLES_FISHLED_PRIORITY
	int "FISHLED task priority"
	default 100

config EXAMPLES_FISHLED_STACKSIZE
	int "FISHLED stack size"
	default 2048

endif
```

## examples/ili9486_lcd/Kconfig
```kconfig
#
# For a description of the syntax of this configuration file,
# see the file kconfig-language.txt in the NuttX tools repository.
#

config EXAMPLES_ILI9486_LCD
	tristate "ILI9486 LCD test"
	default n
	---help---
		Enables a simple test of an ili9486 LCD

if EXAMPLES_ILI9486_LCD

config EXAMPLES_ILI9486_LCD_DEVNAME
	string "ILI9486 LCD device path"
	default "/dev/ili9486"
	---help---
		The full path to the ILI9486 LCD device to be tested

endif
```

## system/regmap/Kconfig
```kconfig
#
# For a description of the syntax of this configuration file,
# see the file kconfig-language.txt in the NuttX tools repository.
#

config SYSTEM_REGMAP
	tristate "registers load/store tool"
	default n
	---help---
		tools for load/store devices' registers in a batch run.
```
